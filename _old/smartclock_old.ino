/*
  Scroll through Chinese characters
  u8g2_font_logisoso32_tn 
  u8g2_font_wqy12_t_gb2312
*/

#include <U8g2lib.h>
#include <ESP8266WiFi.h>
#include <WiFiUdp.h>
#include <ArduinoJson.h>
#include <TimeLib.h>
#include <FS.h>

//U8G2_SSD1306_128X64_NONAME_1_HW_I2C u8g2(U8G2_R0, /* reset=*/ U8X8_PIN_NONE);
//#define CTG_U8G2_t U8G2_SSD1306_128X64_NONAME_F_4W_HW_SPI
#define CTG_U8G2_t U8G2_ST7565_64128N_F_4W_HW_SPI

#ifdef U8X8_HAVE_HW_SPI
#include <SPI.h>
#endif
#ifdef U8X8_HAVE_HW_I2C
#include <Wire.h>
#endif

#include "scroll_string.h"
#include "network_funs.h"
#include "SpaceTrash.h"
#include "tg2048.h"
#include "ddz.h"

#define FUNS_OF_IT 9

//CTG_U8G2_t u8g2(U8G2_R0,U8X8_PIN_NONE,D0,D2);
CTG_U8G2_t u8g2(U8G2_R2,U8X8_PIN_NONE,D0,D2);


// width: 48, height: 48
static const unsigned char bmp_storm_snow[] U8X8_PROGMEM = { 0x00,0x00,0x00,0x7f,0x00,0x00,0x00,0x00,0xe0,0xc1,0x01,0x00,0x00,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0x00,0x0a };
// width: 48, height: 48
static const unsigned char bmp_storm_rain[] U8X8_PROGMEM = { 0x00,0x00,0x00,0x7f,0x00,0x00,0x00,0x00,0xe0,0xc1,0x01,0x00,0x00,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0x83,0x0f };
// width: 48, height: 48
static const unsigned char bmp_heavy_snow[] U8X8_PROGMEM = { 0x00,0x00,0x00,0x7f,0x00,0x00,0x00,0x00,0xe0,0xc1,0x01,0x00,0x00,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0x00,0x00 };
// width: 48, height: 48
static const unsigned char bmp_heavy_rain[] U8X8_PROGMEM = { 0x00,0x00,0x00,0x7f,0x00,0x00,0x00,0x00,0xe0,0xc1,0x01,0x00,0x00,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0x80,0x0f };
// width: 48, height: 48
static const unsigned char bmp_ice_rain[] U8X8_PROGMEM = { 0x00,0x00,0x00,0x7f,0x00,0x00,0x00,0x00,0xe0,0xc1,0x01,0x00,0x00,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0x08,0x00 };
// width: 48, height: 48
static const unsigned char bmp_cloudy[] U8X8_PROGMEM = { 0x00,0x00,0x00,0x00,0x00,0x00,0x00,0x00,0x00,0x00,0x00,0x00,0x00,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0x00,0x00 };
// width: 48, height: 48
static const unsigned char bmp_cloudy_night[] U8X8_PROGMEM = { 0x00,0x00,0xf8,0x00,0x00,0x00,0x00,0x00,0xc0,0x00,0x00,0x00,0x00,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0x7f,0x00 };
// width: 48, height: 48
static const unsigned char bmp_thundershower[] U8X8_PROGMEM = { 0x00,0x00,0x00,0x7f,0x00,0x00,0x00,0x00,0xe0,0xc1,0x01,0x00,0x00,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0x00,0x1f };
// width: 48, height: 48
static const unsigned char bmp_haze[] U8X8_PROGMEM = { 0x00,0x00,0x00,0x00,0x00,0x00,0x00,0x1c,0x00,0x00,0x00,0x00,0x00,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0x00,0x00 };
// width: 48, height: 48
static const unsigned char bmp_sunny[] U8X8_PROGMEM = { 0x00,0x00,0x00,0x00,0x00,0x00,0x00,0x00,0x00,0x00,0x00,0x00,0x00,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0x00,0x00 };
// width: 48, height: 48
static const unsigned char bmp_sunny_night[] U8X8_PROGMEM = { 0x00,0x00,0x00,0x00,0x00,0x00,0x00,0x00,0xf0,0x01,0x00,0x00,0x00,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0x00,0x00 };
// width: 48, height: 48
static const unsigned char bmp_dust[] U8X8_PROGMEM = { 0x00,0x00,0x00,0x00,0x00,0x00,0x00,0x00,0x00,0x00,0x00,0x00,0x00,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0x00,0x00 };
// width: 48, height: 48
static const unsigned char bmp_fog[] U8X8_PROGMEM = { 0x00,0x00,0x00,0x00,0x00,0x00,0x00,0x00,0x00,0x00,0x00,0x00,0x00,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0x00,0x00 };
// width: 48, height: 48
static const unsigned char bmp_light_snow[] U8X8_PROGMEM = { 0x00,0x00,0x00,0x7f,0x00,0x00,0x00,0x00,0xe0,0xc1,0x01,0x00,0x00,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0x00,0x00 };
// width: 48, height: 48
static const unsigned char bmp_light_rain[] U8X8_PROGMEM = { 0x00,0x00,0x00,0x7f,0x00,0x00,0x00,0x00,0xe0,0xc1,0x01,0x00,0x00,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0x00,0x00 };
// width: 48, height: 48
static const unsigned char bmp_overcast[] U8X8_PROGMEM = { 0x00,0x00,0x00,0x00,0x00,0x00,0x00,0x00,0x00,0x00,0x00,0x00,0x00,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0x00,0x00 };
// width: 48, height: 48
static const unsigned char bmp_sleet[] U8X8_PROGMEM = { 0x00,0x00,0x00,0x7f,0x00,0x00,0x00,0x00,0xe0,0xc1,0x01,0x00,0x00,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0x00,0x00 };
// width: 48, height: 48
static const unsigned char bmp_snow_flurry[] U8X8_PROGMEM = { 0x00,0x00,0x00,0xe0,0x00,0x00,0x00,0x00,0x40,0x30,0xf0,0x00,0x00,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0x00,0x00 };
// width: 48, height: 48
static const unsigned char bmp_shower[] U8X8_PROGMEM = { 0x00,0x00,0x00,0xe0,0x00,0x00,0x00,0x00,0x40,0x30,0xf0,0x00,0x00,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0x00,0x00 };
// width: 48, height: 48
static const unsigned char bmp_mod_snow[] U8X8_PROGMEM = { 0x00,0x00,0x00,0x7f,0x00,0x00,0x00,0x00,0xe0,0xc1,0x01,0x00,0x00,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0x00,0x00 };
// width: 48, height: 48
static const unsigned char bmp_mod_rain[] U8X8_PROGMEM = { 0x00,0x00,0x00,0x7f,0x00,0x00,0x00,0x00,0xe0,0xc1,0x01,0x00,0x00,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0x0f,0x00 };
// width: 48, height: 48
static const unsigned char ctg_logo[] U8X8_PROGMEM = { 0xfc,0xff,0xff,0xff,0xff,0x3f,0xfe,0xff,0xff,0xff,0xff,0x7f,0xff,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0xff,0x3c };
const unsigned char *windex[32]=
{
  bmp_sunny,  bmp_sunny_night,  bmp_sunny,  bmp_sunny_night,
  bmp_cloudy,  bmp_cloudy,  bmp_cloudy_night,  bmp_cloudy,
  
  bmp_cloudy_night,  bmp_overcast,  bmp_shower,  bmp_thundershower,
  bmp_thundershower,  bmp_light_rain,  bmp_mod_rain,  bmp_heavy_rain,

  bmp_storm_rain,  bmp_storm_rain,  bmp_storm_rain,  bmp_ice_rain,
  bmp_sleet,  bmp_snow_flurry,  bmp_light_snow,  bmp_mod_snow,

  bmp_heavy_snow,  bmp_storm_snow,  bmp_dust,  bmp_dust,
  bmp_dust,  bmp_dust,  bmp_fog,  bmp_haze};
const char *wnames[40]=
{
  "Sunny",  "Clear",  "sunny",  "clear",
  "Cloudy",  "PaCloud",  "PaCloud",  "MoCloud",
  
  "MoCloud",  "Ovrcast",  "Shower",  "Thunder",
  "HailThd",  "LiRain",  "MoRain",  "HvRain",

  "Stormy",  "HvStorm",  "SeStorm",  "IceRain",
  "Sleet",  "Flurry",  "LiSnow",  "MoSnow",

  "HvSnow",  "SnowStm",  "Dustful",  "Sandful",
  "DustStm",  "SandStm",  "Foggy",  "Haze",
  
  "Windy",  "Bluster",  "Hurrica",  "",
  "Tornado",  "Cold",  "Hot",  "Unknown"};
  
const char *funs[FUNS_OF_IT]=
{"查看自述文件","TCP 客户端实验","TCP 服务器实验","文件浏览器",
"串口输入输出控制器","系统设置","斗地主OL","SpaceTrash","2048 Classic"
};
const char *t_settings[6]=
{"WiFi 设置","NTP时间服务器修改","天气城市修改",
"天气服务器密钥修改","显示对比度","显示亮度"
};
//Setting this small library.



// Chinese Short Story
// The Farmer God Shen Nong Tastes All the Plants 
// Please excause wrong line breaks
const char a_str[] = "自述文件\n待写区域，等到成品除了以后再撰写吧\n\n"
"翻译我就不翻译了，毕竟不是什么好话，大致就是没什么知名度。有些人在网上查了这部电影的评价，看着不错就去看了。没错，这就是去年上映时日本人评价的。由于同期的大电影，鬼灭之刃：无限列车的原因，就在吹替版在日本上映的第一天，有些电影院去看这部电影的人少之又少（我是看推特的有些人这么说），可以说是大概快包场的地步。我以为这部要被鬼灭的热度压下去，又要成为一个不知名的电影时，奇迹发生了。\n"

"  群众的眼睛是雪亮的，看过的人纷纷都在各大论坛开始评论起了这部电影，有的赞扬，有的客观评价，有的分析这部电影的剧情，差评几乎看不到。我几乎天天刷推特，我看到有些人看了之后二刷，三刷，我看到还有十几刷（不夸张，我在推特亲眼看到的）、有些人安利自己的朋友，家人，强行拉去看的。有些人还找漫画和TV版动画看，没有日文翻译就看生肉。在短短的一周内，这部电影就上了推特热搜。\n"
"满分5分，这个分数，在日本人的眼里，是非常高的评价。\n"
"来对比一下其他的知名动画电影的评分\n"
"千与千寻：4.1\n鬼灭之刃：4.1\n你的名字：4.0\n在有些网站3.8分\n"
"可见而知4.2分是很高的评价\n"
"这时候电影院已经出现了周末休假座位排满的现象。\n" 
"由于中国没有DVD的文化，不会生产光碟BD售卖。所以日本各大网友强烈要求中国出光碟，说是一定会买，每天我都能在推特看到他们的哀嚎。不过我也不知道会不会出，估计不会吧，毕竟BD这文化，由于各种原因在中国没有发展起来。\n"
"打开推特，罗小黑的同人作品满天飞，点赞和关注量也很高。";

char ddznote_str[1024]=
  "斗地主说明文档\nCopyright (c) Createen Studios 2021\n版本 Beta v0.1.5\n"
  "新功能: 增加了部分场景的非线性动画，增加了“春天”（3倍）的判定，防止因为丢包造成的游戏无法继续 修复BUG: 房主在准备界面很可能崩溃 叫分界面可能出问题(比如底牌突然出现),丢包检测未响应,出牌会有极小概率失败\n"
  "本项目属于开源项目，任何人不可将此游戏代码用于商业用途\n操作说明：\n"
  "左键、右键为选择方向键，中键为确定键。\n叫分环节和非自己出牌环节可以按住左、右键来查看自己的手牌。\n"
  "玩家身份图标为“地主”或者“农民”，左边的数字代表玩家剩余牌数，右边的五边形图标代表玩家的出牌状态。\n"
  "若为实心则说明此玩家正在出牌，若中间有一横线，则说明最近的一次出牌由此玩家所出。\n"
  "Build date: "
;
char t_ext[256] =" ";
const char* GenshinDayEvent[24]={
  "","","","所有材料","明天刷新","龙狼声望","自由繁荣","高塔破瓦","孤云寒林","抗争勤劳","凛风狼牙","雾海铅丹","诗文黄金","狮牙手铐","漆黑陨铁",
  "自由繁荣","高塔破瓦","孤云寒林","抗争勤劳","凛风狼牙","雾海铅丹","诗文黄金","狮牙手铐","漆黑陨铁"
};
const char* cnames[5]={"未用树脂","只用1点","20点","60点","40点"};

 //---------------------------------start---------------------------------
char host[64] = "api.seniverse.com";
char APIKEY[64] = "SpOqrpcw5o1bNa8Lf";        //API KEY
char city[CITY_LENGTH] = "hangzhou";
const char* language = "zh-Hans";//zh-Hans 简体中文  会显示乱码
const char* dayname[DAYS]={"今","明","后"};

char ntpServerName[64] = "cn.ntp.org.cn";
const int timeZone = 8;//北京时间在东8区

const unsigned long BAUD_RATE = 115200;                   // serial connection speed
const unsigned long HTTP_TIMEOUT = 5000;               // max respone time from server
const size_t MAX_CONTENT_SIZE = 4000;                   // max size of the HTTP response
 
// 我们要从此网页中提取的数据的类型

  
WiFiClient client;
char response[MAX_CONTENT_SIZE];
char endOfHeaders[] = "\r\n\r\n";

 WiFiUDP Udp;
 unsigned int localPort = 1337;
uint8_t ntp_available = 0;
 //---------------------------------end---------------------------------
char c_a_time[10]="";
char c_a_date[16]="";
const char *c_a_weekname[7]={
  "SUN","MON","TUE","WED","THU","FRI","SAT"
};
uint8_t c_a_week=0;
char current_wea[16]="";

 
void setup(void) {
  pinMode(D1,INPUT_PULLUP);
  pinMode(D3,INPUT_PULLUP);
  pinMode(D4,INPUT_PULLUP);
  analogWrite(D8,1023);
  strcat(ddznote_str,__TIME__);
  strcat(ddznote_str,__DATE__);
  Serial.begin(115200);
  u8g2.begin();  
  u8g2.enableUTF8Print();
  u8g2.setFont(u8g2_font_wqy12_t_gb2312);
  if(!SPIFFS.begin()){
    Serial.println("Start SPIFFS Failed!please check Arduino Download Config.");
   for(;;) yield();
  }

  
  WiFi.mode(WIFI_STA);
  while(connect_to_WiFi(1)==5) yield();
  
  drawList("正在连接到NTP服务器",ntpServerName,"","",1);
  Udp.begin(localPort);
  setSyncProvider(getNtpTime);
  setSyncInterval(600);
  Serial.print("IP address: ");
  Serial.println(WiFi.localIP());//WiFi.localIP()返回8266获得的ip地址
  client.setTimeout(HTTP_TIMEOUT);
  drawList("正在连接到天气服务器",host,__TIME__,__DATE__,1,0);
  
  
  
  
}
void loop(void) {
  //TCPTest();
  //FileExplorer();
  //getchs(c_str1,127);
  //connect_to_WiFi(0);
  //scroll_string(a_str);
  
  u8g2.setFont(u8g2_font_wqy12_t_gb2312);
  u8g2_uint_t offset=0;      
  u8g2_uint_t twidth;
  Serial.println(t_ext);
  Serial.println(twidth);
  u8g2_uint_t x=0;
  uint8_t quit_to=0;
  for(uint32_t i=0;!quit_to;i++){
    if(digitalRead(D1)==0) break;
    digitalClockDisplay();
    if(WiFi.status()==WL_CONNECTED){
    if((i&127)==0){
      while (!client.connected()){
        if (!client.connect(host, 80)){
          Serial.println("connecting....");
          if(digitalRead(D1)==0) {
            quit_to=1;
            break;
          }
          delay(100);
        }
      }
     if(quit_to) break;
     t_ext[0]=0;
      if (sendRequest(host, city, APIKEY) && skipResponseHeaders()) {
    //清除缓冲
        clrEsp8266ResponseBuffer();
    //读取响应数据
        readReponseContent(response, sizeof(response));
        WeatherData weatherData;
        if (parseUserData(response, &weatherData)) {
          printUserData(&weatherData);
        }
      }
    }
    }
    else strcpy(t_ext,"   未获取到天气信息");
    twidth = u8g2.getUTF8Width(t_ext);
    u8g2.clearBuffer();
    switch(i%3){
      case 0:
      u8g2.drawXBMP(0,16, 48, 48, windex[0]);
      break;
      case 1:
      u8g2.drawBox(0,16, 49, 48);
      u8g2.setColorIndex(0);
      u8g2.setCursor(1,26);
      u8g2.print("今日可打");
      u8g2.setCursor(1,38);
      u8g2.print(GenshinDayEvent[3*weekday()]);
      u8g2.setCursor(1,50);
      u8g2.print(GenshinDayEvent[3*weekday()+1]);
      u8g2.setCursor(1,62);
      u8g2.print(GenshinDayEvent[3*weekday()+2]);
      u8g2.setColorIndex(1);
      break;
      case 2:
      u8g2.drawCircle(23,39,23);
      u8g2.setCursor(12,30);
      u8g2.print("杭电");
      u8g2.setCursor(6,42);
      u8g2.print("线代英");
      u8g2.setCursor(6,54);
      u8g2.print("语免挂");
      break;
      /*
      case 3:
      u8g2.drawXBMP(0,16, 48, 48, ctg_logo);
      break;*/
    }
    u8g2.setFont(u8g2_font_logisoso26_tn );
    u8g2.setCursor(49, 44);
    u8g2.print(c_a_time);
    u8g2.setFont(u8g2_font_6x10_tf);
    u8g2.setCursor(50, 54);
    u8g2.print(c_a_date);
    u8g2.setCursor(111, 54);
    u8g2.print(c_a_weekname[c_a_week]);
    u8g2.setCursor(50, 62);
  //u8g2.print("Createen Stug");
  //u8g2.print("Sunny,-10\xb0\x43");
  //176(0xb0) 摄氏度
    u8g2.print("Resin: ");
    int resinr;
    u8g2.print((resinr=GenshinResinRest())/10);
    u8g2.print(".");
    u8g2.print(resinr%10);
    u8g2.setFont(u8g2_font_wqy12_t_gb2312);
    u8g2.sendBuffer();
    for(int si=0;si<256;si++){
      u8g2.setColorIndex(0);
      u8g2.drawBox(0,0,128,16);
      u8g2.setColorIndex(1);
      x=offset; 
      do {                // repeated drawing of the scrolling text...
        u8g2.drawUTF8(x, 12, t_ext);     // draw the scolling text
        x += twidth;           // add the pixel width of the scrolling text
      } while( x < u8g2.getDisplayWidth() );    // draw again until the complete display is filled
      u8g2.sendBuffer();
      offset-=1;              // scroll by one pixel
      if ( (u8g2_uint_t)offset < (u8g2_uint_t)-twidth )  
        offset = 0;             // start over again
      delay(5);
      
      if(digitalRead(D1)==0) {
        while(digitalRead(D1)==0) yield();
        delay(30);
        quit_to=1;
        break;
      }
      if(digitalRead(D4)==0){
        int resinCost=controlBoard(cnames);
        u8g2.setColorIndex(0);
        u8g2.drawBox(3,23,124,17);
        u8g2.setColorIndex(1);
        drawframe(3,23,124,17);
        u8g2.setCursor(5,36);
        u8g2.setFont(u8g2_font_wqy12_t_gb2312);
        u8g2.print("树脂消耗");
        if(resinCost==3) resinCost=6;
        u8g2.print(resinCost*10);
        u8g2.print("点,剩余");
        if(resinCost==1) u8g2.print(GenshinResinRest(10)/10);
        else u8g2.print(GenshinResinRest(resinCost*100)/10);
        u8g2.sendBuffer();
        while(digitalRead(D4)==0) yield();
        delay(1100);
        break;
      }
    }
  }
/*  const char *funs[FUNS_OF_IT]=
{"TCP 客户端实验","TCP 服务器实验","文件浏览器",
"自述文件查看","串口输入输出控制器","系统设置","斗地主OL"
};
const char *t_settings[6]=
{"WiFi 设置","NTP时间服务器修改","天气城市修改","天气服务器密钥修改",
"","显示亮度"
};*/
  while(1){
    uint8_t selected=listdraw("应用和功能",funs,FUNS_OF_IT);
    if(selected==255) break;
    switch(selected){
      case 0: scroll_string(a_str); break;
      case 1: TCPTest(); break;
      case 2: TCPServerTest(); break;
      case 3: FileExplorer(); break;
      case 4: Serial_monitor(); break;
      case 5: while(1){
      uint8_t set_selected=listdraw("系统设置面板",t_settings,6);
      uint8_t retry=0;
    if(set_selected==255) break;
    switch(set_selected){
      case 0: 
        connect_to_WiFi(2);
        if(WiFi.status()==WL_CONNECTED) setTime(getNtpTime());
      break;
      case 1: {
        char nam_bf[64]="";
        strcpy(nam_bf,ntpServerName);
        getchs(nam_bf,64);
        drawList(ntpServerName,"确认要修改NTP地址为",nam_bf,"可能会导致时间不准确",1);
        while(digitalRead(D1) && digitalRead(D3)) yield();
        if(digitalRead(D1)) retry=1;
        while(!digitalRead(D1) || !digitalRead(D3)) yield();
        delay(30);
        strcpy(ntpServerName,nam_bf);
      }
      break;
      case 2:{
        char nam_bf[CITY_LENGTH]="";
        strcpy(nam_bf,city);
        getchs(nam_bf,CITY_LENGTH);
        drawList("确认要修改城市",city,"为它吗?",nam_bf,1);
        while(digitalRead(D1) && digitalRead(D3)) yield();
        if(digitalRead(D1)) retry=2;
        while(!digitalRead(D1) || !digitalRead(D3)) yield();
        delay(30);
        strcpy(city,nam_bf);
      } 
      break;
      case 3: {
        char nam_bf[64]="";
        strcpy(nam_bf,APIKEY);
        getchs(nam_bf,64);
        drawList("确认要修改APIkey?",APIKEY,nam_bf,"可能导致天气无法获取",1);
        while(digitalRead(D1) && digitalRead(D3)) yield();
        if(digitalRead(D1)) retry=3;
        while(!digitalRead(D1) || !digitalRead(D3)) yield();
        delay(30);
        strcpy(APIKEY,nam_bf);
      } 
      break;
      case 4: {
      int con_t=slider("设置对比度",255);
      if(con_t!=-32768) u8g2.setContrast(con_t);
      }
      break;
      case 5: {
      int con_t=slider("设置亮度",1023);
      if(con_t!=-32768) analogWrite(D8,con_t);
      }
      break;
    }
    }
      break;
      case 6: dodizhu(); break;
      case 7: _spacetrash(); break;
      case 8: tg2048_setup(); tg2048_loop(); break;
    }
    
  }
}
