/*  57 64 46940
  Scroll through Chinese characters
  u8g2_font_logisoso32_tn 
  u8g2_font_wqy12_t_gb2312
*/

#include <U8g2lib.h>
#include <ESP8266WiFi.h>
#include <WiFiUdp.h>
#include <ArduinoJson.h>
#include <TimeLib.h>
#include <FS.h>

#include <ESP8266SDUpdater.h>
SDUpdater sdUpdater;
#include "ctg_stack.h"

//U8G2_SSBtnL306_128X64_NONAME_F_HW_I2C u8g2(U8G2_R0, /* reset=*/ U8X8_PIN_NONE);
//#define CTG_U8G2_t U8G2_SSBtnL306_128X64_NONAME_F_4W_HW_SPI
//#define CTG_U8G2_t U8G2_ST7565_64128N_F_4W_HW_SPI

#ifdef U8X8_HAVE_HW_SPI
#include <SPI.h>
#endif
#ifdef U8X8_HAVE_HW_I2C
#include <Wire.h>
#endif


#include "ctg_stack.h"
#include "SpaceTrash.h"
#include "tg2048.h"
#include "ddz.h"

#define FUNS_OF_IT 10
U8G2_SSD1306_128X64_NONAME_F_4W_HW_SPI u8g2(U8G2_R0,U8X8_PIN_NONE,CTG_OLED_DC,CTG_OLED_RST);

// width: 48, height: 48
static const unsigned char bmp_storm_snow[] PROGMEM = { 0x00,0x00,0x00,0x7f,0x00,0x00,0x00,0x00,0xe0,0xc1,0x01,0x00,0x00,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0x00,0x0a };
// width: 48, height: 48
static const unsigned char bmp_storm_rain[] PROGMEM = { 0x00,0x00,0x00,0x7f,0x00,0x00,0x00,0x00,0xe0,0xc1,0x01,0x00,0x00,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0x83,0x0f };
// width: 48, height: 48
static const unsigned char bmp_heavy_snow[] PROGMEM = { 0x00,0x00,0x00,0x7f,0x00,0x00,0x00,0x00,0xe0,0xc1,0x01,0x00,0x00,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0x00,0x00 };
// width: 48, height: 48
static const unsigned char bmp_heavy_rain[] PROGMEM = { 0x00,0x00,0x00,0x7f,0x00,0x00,0x00,0x00,0xe0,0xc1,0x01,0x00,0x00,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0x80,0x0f };
// width: 48, height: 48
static const unsigned char bmp_ice_rain[] PROGMEM = { 0x00,0x00,0x00,0x7f,0x00,0x00,0x00,0x00,0xe0,0xc1,0x01,0x00,0x00,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0x08,0x00 };
// width: 48, height: 48
static const unsigned char bmp_cloudy[] PROGMEM = { 0x00,0x00,0x00,0x00,0x00,0x00,0x00,0x00,0x00,0x00,0x00,0x00,0x00,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0x00,0x00 };
// width: 48, height: 48
static const unsigned char bmp_cloudy_night[] PROGMEM = { 0x00,0x00,0xf8,0x00,0x00,0x00,0x00,0x00,0xc0,0x00,0x00,0x00,0x00,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0x7f,0x00 };
// width: 48, height: 48
static const unsigned char bmp_thundershower[] PROGMEM = { 0x00,0x00,0x00,0x7f,0x00,0x00,0x00,0x00,0xe0,0xc1,0x01,0x00,0x00,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0x00,0x1f };
// width: 48, height: 48
static const unsigned char bmp_haze[] PROGMEM = { 0x00,0x00,0x00,0x00,0x00,0x00,0x00,0x1c,0x00,0x00,0x00,0x00,0x00,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0x00,0x00 };
// width: 48, height: 48
static const unsigned char bmp_sunny[] PROGMEM = { 0x00,0x00,0x00,0x00,0x00,0x00,0x00,0x00,0x00,0x00,0x00,0x00,0x00,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0x00,0x00 };
// width: 48, height: 48
static const unsigned char bmp_sunny_night[] PROGMEM = { 0x00,0x00,0x00,0x00,0x00,0x00,0x00,0x00,0xf0,0x01,0x00,0x00,0x00,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0x00,0x00 };
// width: 48, height: 48
static const unsigned char bmp_dust[] PROGMEM = { 0x00,0x00,0x00,0x00,0x00,0x00,0x00,0x00,0x00,0x00,0x00,0x00,0x00,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0x00,0x00 };
// width: 48, height: 48
static const unsigned char bmp_fog[] PROGMEM = { 0x00,0x00,0x00,0x00,0x00,0x00,0x00,0x00,0x00,0x00,0x00,0x00,0x00,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0x00,0x00 };
// width: 48, height: 48
static const unsigned char bmp_light_snow[] PROGMEM = { 0x00,0x00,0x00,0x7f,0x00,0x00,0x00,0x00,0xe0,0xc1,0x01,0x00,0x00,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0x00,0x00 };
// width: 48, height: 48
static const unsigned char bmp_light_rain[] PROGMEM = { 0x00,0x00,0x00,0x7f,0x00,0x00,0x00,0x00,0xe0,0xc1,0x01,0x00,0x00,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0x00,0x00 };
// width: 48, height: 48
static const unsigned char bmp_overcast[] PROGMEM = { 0x00,0x00,0x00,0x00,0x00,0x00,0x00,0x00,0x00,0x00,0x00,0x00,0x00,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0x00,0x00 };
// width: 48, height: 48
static const unsigned char bmp_sleet[] PROGMEM = { 0x00,0x00,0x00,0x7f,0x00,0x00,0x00,0x00,0xe0,0xc1,0x01,0x00,0x00,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0x00,0x00 };
// width: 48, height: 48
static const unsigned char bmp_snow_flurry[] PROGMEM = { 0x00,0x00,0x00,0xe0,0x00,0x00,0x00,0x00,0x40,0x30,0xf0,0x00,0x00,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0x00,0x00 };
// width: 48, height: 48
static const unsigned char bmp_shower[] PROGMEM = { 0x00,0x00,0x00,0xe0,0x00,0x00,0x00,0x00,0x40,0x30,0xf0,0x00,0x00,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0x00,0x00 };
// width: 48, height: 48
static const unsigned char bmp_mod_snow[] PROGMEM = { 0x00,0x00,0x00,0x7f,0x00,0x00,0x00,0x00,0xe0,0xc1,0x01,0x00,0x00,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0x00,0x00 };
// width: 48, height: 48
static const unsigned char bmp_mod_rain[] PROGMEM = { 0x00,0x00,0x00,0x7f,0x00,0x00,0x00,0x00,0xe0,0xc1,0x01,0x00,0x00,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0x0f,0x00 };
// width: 48, height: 48
static const unsigned char ctg_logo[] PROGMEM = { 0xfc,0xff,0xff,0xff,0xff,0x3f,0xfe,0xff,0xff,0xff,0xff,0x7f,0xff,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0xff,0x3c };
const unsigned char *windex[32]=
{
  bmp_sunny,  bmp_sunny_night,  bmp_sunny,  bmp_sunny_night,
  bmp_cloudy,  bmp_cloudy,  bmp_cloudy_night,  bmp_cloudy,
  
  bmp_cloudy_night,  bmp_overcast,  bmp_shower,  bmp_thundershower,
  bmp_thundershower,  bmp_light_rain,  bmp_mod_rain,  bmp_heavy_rain,

  bmp_storm_rain,  bmp_storm_rain,  bmp_storm_rain,  bmp_ice_rain,
  bmp_sleet,  bmp_snow_flurry,  bmp_light_snow,  bmp_mod_snow,

  bmp_heavy_snow,  bmp_storm_snow,  bmp_dust,  bmp_dust,
  bmp_dust,  bmp_dust,  bmp_fog,  bmp_haze};
const char *wnames[40]=
{
  "Sunny",  "Clear",  "sunny",  "clear",
  "Cloudy",  "PaCloud",  "PaCloud",  "MoCloud",
  
  "MoCloud",  "Ovrcast",  "Shower",  "Thunder",
  "HailThd",  "LiRain",  "MoRain",  "HvRain",

  "Stormy",  "HvStorm",  "SeStorm",  "IceRain",
  "Sleet",  "Flurry",  "LiSnow",  "MoSnow",

  "HvSnow",  "SnowStm",  "Dustful",  "Sandful",
  "DustStm",  "SandStm",  "Foggy",  "Haze",
  
  "Windy",  "Bluster",  "Hurrica",  "",
  "Tornado",  "Cold",  "Hot",  "Unknown"};
  
const char *funs[FUNS_OF_IT] =
{"开始前必读文档","TCP 客户端实验","TCP 服务器实验","文件浏览器",
"串口输入输出控制器","系统设置","斗地主OL","SpaceTrash","2048 Classic","APP列表"
};
const char *t_settings[5] =
{"WiFi 设置","NTP时间服务器修改","天气城市修改",
"天气服务器密钥修改","显示亮度"
};
//Setting this small library.



// Chinese Short Story
// The Farmer God Shen Nong Tastes All the Plants 
// Please excause wrong line breaks
const char a_str[] = "开始使用前必读\n\n"
"1.各位大佬们请自己设置天气城市和APIKey，在选择“应用和功能”界面长按中间键可以返回到时钟界面，错误的城市和ApiKey会让设备卡顿。若想要从时钟界面进入应用与功能界面需要再按一次左键哦\n"
"2.关于原神树脂计数器，在时钟界面按右键可以进入计数器。选择“只用1点”选项可以校准你的原粹树脂的真实数值\n"
"3.关于斗地主，需要3个设备同时运行此固件，其中一个选择开新房间，另外2个选择加入房间。在“点击准备”界面里长按左键可以退出游戏，其他界面内无法退出游戏。\n"
"4.SpaceTrash为U8g2自带的游戏，2048为其他人写的源码。游玩这两款游戏时，同时按住左、右键将会随时保存并退出。游玩2048时，按住中间键后左键向上，右键向下。\n"
"5.TCP服务器实验、串口监视器尚未完成，制作不易哦\n"
"Copyright (c) Createen Studios 2021\n软件版本 Beta v0.1.5\n";

char ddznote_str[1024]=
  "斗地主说明文档\nCopyright (c) Createen Studios 2021\n版本 Beta v0.1.5\n"
  "新功能: 增加了部分场景的非线性动画，增加了“春天”（3倍）的判定，防止因为丢包造成的游戏无法继续 修复BUG: 房主在准备界面很可能崩溃 叫分界面可能出问题(比如底牌突然出现),丢包检测未响应,出牌会有极小概率失败\n"
  "本项目属于开源项目，任何人不可将此游戏代码用于商业用途\n操作说明：\n"
  "左键、右键为选择方向键，中键为确定键。\n叫分环节和非自己出牌环节可以按住左、右键来查看自己的手牌。\n"
  "玩家身份图标为“地主”或者“农民”，左边的数字代表玩家剩余牌数，右边的五边形图标代表玩家的出牌状态。\n"
  "若为实心则说明此玩家正在出牌，若中间有一横线，则说明最近的一次出牌由此玩家所出。\n"
  "Build date: "
;
const char* GenshinDayEvent[24] ={
  "","","","所有材料","明天刷新","龙狼声望","自由繁荣","高塔破瓦","孤云寒林","抗争勤劳","凛风狼牙","雾海铅丹","诗文黄金","狮牙手铐","漆黑陨铁",
  "自由繁荣","高塔破瓦","孤云寒林","抗争勤劳","凛风狼牙","雾海铅丹","诗文黄金","狮牙手铐","漆黑陨铁"
};
const char* cnames[5] ={"未用树脂","只用1点","20点","60点","40点"};

 //---------------------------------start---------------------------------
uint8_t ntp_available = 0;
extern char t_ext[256];
extern char host[];
extern char APIKEY[];        //API KEY
extern char city[CITY_LENGTH] ;
extern const char* language ;//zh-Hans 简体中文  会显示乱码
extern const char* dayname[DAYS];

extern char ntpServerName[] ;
extern const int timeZone ;//北京时间在东8区

extern const unsigned long BAUD_RATE ;                   // serial connection speed
extern const unsigned long HTTP_TIMEOUT ;               // max respone time from server

extern WiFiClient client;
extern char response[MAX_CONTENT_SIZE];
extern char endOfHeaders[];


extern  WiFiUDP Udp;
extern  unsigned int localPort ;
extern char c_a_time[];
extern char c_a_date[];
extern const char *c_a_weekname[];
extern uint8_t c_a_week;
 //---------------------------------end---------------------------------

 
void setup(void) {
  strcat(ddznote_str,__TIME__);
  strcat(ddznote_str,__DATE__);
  Serial.begin(115200);
  if(!SPIFFS.begin()){
    Serial.println("Start SPIFFS Failed!please check Arduino Download Config.");
   for(;;) yield();
  }
  ctg_init(1);
  if(digitalRead(BtnL)){
    WiFi.mode(WIFI_STA);
    while(connect_to_WiFi(1)==5) yield();
    getCityApikey(city,APIKEY,0);
    drawList("正在连接到NTP服务器",ntpServerName,"","",1);
    Udp.begin(localPort);
    setSyncProvider(getNtpTime);
    setSyncInterval(600);
    Serial.print("IP address: ");
    Serial.println(WiFi.localIP());//WiFi.localIP()返回8266获得的ip地址
    client.setTimeout(HTTP_TIMEOUT);
    drawList("正在连接到天气服务器",host,__TIME__,__DATE__,1,0);
  }
  else WiFi.disconnect();
  
  
}
void loop(void) {
  //TCPTest();
  //FileExplorer();
  //getchs(c_str1,127);
  //connect_to_WiFi(0);
  //scroll_string(a_str);
  u8g2.setFont(u8g2_font_wqy12_t_gb2312);
  u8g2_uint_t offset=0;      
  u8g2_uint_t twidth;
  Serial.println(t_ext);
  Serial.println(twidth);
  u8g2_uint_t x=0;
  uint8_t quit_to=0;
  for(uint32_t i=0;!quit_to && SPIFFS.exists(weather_config_file);i++){
    if(digitalRead(BtnL)==0) break;
    digitalClockDisplay();
    if(WiFi.status()==WL_CONNECTED){
    if((i&255)==0){
      while (!client.connected()){
        if (!client.connect(host, 80)){
          Serial.println("connecting....");
          if(digitalRead(BtnL)==0) {
            quit_to=1;
            break;
          }
          delay(100);
        }
      }
     if(quit_to) break;
     t_ext[0]=0;
      if (sendRequest(host, city, APIKEY) && skipResponseHeaders()) {
    //清除缓冲
        clrEsp8266ResponseBuffer();
    //读取响应数据
        readReponseContent(response, sizeof(response));
        WeatherData weatherData;
        if (parseUserData(response, &weatherData)) {
          printUserData(&weatherData);
        }
      }
    }
    }
    else strcpy(t_ext,"   未获取到天气信息");
    twidth = u8g2.getUTF8Width(t_ext);
    u8g2.clearBuffer();
    switch(i%3){
      case 0:
      u8g2.drawXBMP(0,16, 48, 48, windex[0]);
      break;
      case 1:
      u8g2.drawBox(0,16, 49, 48);
      u8g2.setColorIndex(0);
      u8g2.setCursor(1,26);
      u8g2.print("今日可打");
      u8g2.setCursor(1,38);
      u8g2.print(GenshinDayEvent[3*weekday()]);
      u8g2.setCursor(1,50);
      u8g2.print(GenshinDayEvent[3*weekday()+1]);
      u8g2.setCursor(1,62);
      u8g2.print(GenshinDayEvent[3*weekday()+2]);
      u8g2.setColorIndex(1);
      break;
      case 2:
      u8g2.drawCircle(23,39,23);
      u8g2.setCursor(12,30);
      u8g2.print("期末");
      u8g2.setCursor(6,42);
      u8g2.print("线代英");
      u8g2.setCursor(6,54);
      u8g2.print("语免挂");
      break;
      /*
      case 3:
      u8g2.drawXBMP(0,16, 48, 48, ctg_logo);
      break;*/
    }
    u8g2.setFont(u8g2_font_logisoso26_tn );
    u8g2.setCursor(49, 44);
    u8g2.print(c_a_time);
    u8g2.setFont(u8g2_font_6x10_tf);
    u8g2.setCursor(50, 54);
    u8g2.print(c_a_date);
    u8g2.setCursor(111, 54);
    u8g2.print(c_a_weekname[c_a_week]);
    u8g2.setCursor(50, 62);
  //u8g2.print("Createen Stug");
  //u8g2.print("Sunny,-10\xb0\x43");
  //176(0xb0) 摄氏度
    u8g2.print("Resin: ");
    int resinr;
    u8g2.print((resinr=GenshinResinRest())/10);
    u8g2.print(".");
    u8g2.print(resinr%10);
    u8g2.setFont(u8g2_font_wqy12_t_gb2312);
    u8g2.sendBuffer();
    for(int si=0;si<256;si++){
      u8g2.setColorIndex(0);
      u8g2.drawBox(0,0,128,16);
      u8g2.setColorIndex(1);
      x=offset; 
      do {                // repeated drawing of the scrolling text...
        u8g2.drawUTF8(x, 12, t_ext);     // draw the scolling text
        x += twidth;           // add the pixel width of the scrolling text
      } while( x < u8g2.getDisplayWidth() );    // draw again until the complete display is filled
      u8g2.sendBuffer();
      offset-=1;              // scroll by one pixel
      if ( (u8g2_uint_t)offset < (u8g2_uint_t)-twidth )  
        offset = 0;             // start over again
      delay(5);
      
      if(digitalRead(BtnL)==0) {
        while(digitalRead(BtnL)==0) yield();
        delay(30);
        quit_to=1;
        break;
      }
      if(digitalRead(BtnM)==0){
        int resinCost=controlBoard(cnames);
        u8g2.setColorIndex(0);
        u8g2.drawBox(3,23,124,17);
        u8g2.setColorIndex(1);
        drawframe(3,23,124,17);
        u8g2.setCursor(5,36);
        u8g2.setFont(u8g2_font_wqy12_t_gb2312);
        u8g2.print("树脂消耗");
        if(resinCost==3) resinCost=6;
        u8g2.print(resinCost*10);
        u8g2.print("点,剩余");
        if(resinCost==1) u8g2.print(GenshinResinRest(10)/10);
        else u8g2.print(GenshinResinRest(resinCost*100)/10);
        u8g2.sendBuffer();
        while(digitalRead(BtnR)==0) yield();
        delay(1100);
        break;
      }
    }
  }
/*  const char *funs[FUNS_OF_IT]=
{"TCP 客户端实验","TCP 服务器实验","文件浏览器",
"自述文件查看","串口输入输出控制器","系统设置","斗地主OL"
};
const char *t_settings[6]=
{"WiFi 设置","NTP时间服务器修改","天气城市修改","天气服务器密钥修改",
"","显示亮度"
};*/
  while(1){
    uint8_t selected=listdraw("应用和功能",funs,FUNS_OF_IT);
    if(selected==255) break;
    switch(selected){
      case 0: scroll_string(a_str); break;
      case 1: TCPTest(); break;
      case 2: TCPServerTest(); break;
      case 3: FileExplorer(); break;
      case 4: Serial_monitor(); break;
      case 5: while(1){
      uint8_t set_selected=listdraw("系统设置面板",t_settings,5);
      uint8_t retry=0;
    if(set_selected==255) break;
    switch(set_selected){
      case 0: 
        connect_to_WiFi(2);
        if(WiFi.status()==WL_CONNECTED) setTime(getNtpTime());
      break;
      case 1: {
        char nam_bf[64]="";
        strcpy(nam_bf,ntpServerName);
        getchs(nam_bf,64);
        drawList(ntpServerName,"确认要修改NTP地址为",nam_bf,"取消    确定",1);
        while(digitalRead(BtnL) && digitalRead(BtnM)) yield();
        if(digitalRead(BtnL)) retry=1;//点了确定
        while(!digitalRead(BtnL) || !digitalRead(BtnM)) yield();
        delay(30);
        if(retry==1) {
          drawList("修改NTP地址为",nam_bf,"   成功","",1500,0);
          strcpy(ntpServerName,nam_bf);
        }
      }
      break;
      case 2:{
        char nam_bf[CITY_LENGTH]="";
        strcpy(nam_bf,city);
        getchs(nam_bf,CITY_LENGTH);
        drawList("确认要修改城市",city,nam_bf,"取消    确定",1);
        while(digitalRead(BtnL) && digitalRead(BtnM)) yield();
        if(digitalRead(BtnL)) retry=2;//点了确定
        while(!digitalRead(BtnL) || !digitalRead(BtnM)) yield();
        delay(30);
        if(retry==2) {
          drawList("修改城市为",nam_bf,"   成功","",1500,0);
          strcpy(city,nam_bf);
          getCityApikey(city,APIKEY,1);
        }
      } 
      break;
      case 3: {
        char nam_bf[64]="";
        strcpy(nam_bf,APIKEY);
        getchs(nam_bf,64);
        drawList("确认要修改APIkey?",APIKEY,nam_bf,"取消    确定",1);
        while(digitalRead(BtnL) && digitalRead(BtnM)) yield();
        if(digitalRead(BtnL)) retry=3;//点了确定
        while(!digitalRead(BtnL) || !digitalRead(BtnM)) yield();
        delay(30);
        if(retry==3) {
          drawList("修改APIkey为",nam_bf,"   成功","",1500,0);
          strcpy(APIKEY,nam_bf);
          getCityApikey(city,APIKEY,1);
        }
      } 
      break;
      case 4: 
      int con_t=slider("设置亮度",255);
      if(con_t!=-32768) u8g2.setContrast(con_t);
      break;
    }
    }
      break;
      case 6: dodizhu(); break;
      case 7: _spacetrash(); break;
      case 8: tg2048_setup(); tg2048_loop(); break;
      case 9: 
      sdUpdater.updateFromSD();
      ESP.restart();
    }
    
  }
}
